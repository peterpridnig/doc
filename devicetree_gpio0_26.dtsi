/* This file was auto-generated by TI PinMux on 9/26/2023 at 8:25:08 PM. */
/* This file should only be used as a reference. Some pins/peripherals, */
/* depending on your use case, may need additional configuration. */


&am33xx_pinmux {
	mygpio1_pins_default: mygpio1_pins_default {
		pinctrl-single,pins = <
			AM33XX_IOPAD(0x828, PIN_INPUT | MUX_MODE7) /* (T12) gpmc_ad10.gpio0[26] */
		>;
	};

	/* Optional sleep pin settings. Must manually enter values in the below skeleton. */
	mygpio1_pins_sleep: mygpio1_pins_sleep {
		pinctrl-single,pins = <
			AM33XX_IOPAD(0x828,  ) /* (T12) gpmc_ad10.gpio0[26] */
		>;
	};

};
